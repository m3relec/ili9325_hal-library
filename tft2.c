/*
                           ....::::: In The Name Of GOD :::::....

    TFT LCD (ILI9325-ILI9320 LCD Driver) Functions
    By Ali Imanifar   Shahrood University of Technology    1389/06/16   

*/
 
#include "tft2.h"
#include "stm32f1xx_hal.h"
#include "Graphic.h"


unsigned char x_text=0,y_text=0;


const unsigned char font8x16[97][16]= 
{
0x00,0x00,0x00,0x00,0x00,0x00,0x00,0x00,0x00,0x00,0x00,0x00,0x00,0x00,0x00,0x00, // space 0x20
0x00,0x00,0x18,0x3C,0x3C,0x3C,0x18,0x18,0x18,0x00,0x18,0x18,0x00,0x00,0x00,0x00, // !
0x00,0x63,0x63,0x63,0x22,0x00,0x00,0x00,0x00,0x00,0x00,0x00,0x00,0x00,0x00,0x00, // "
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0x00,0x70,0xD8,0xD8,0x70,0x00,0x00,0x00,0x00,0x00,0x00,0x00,0x00,0x00,0x00,0x00  // DEL
};  




void LCD_DATAPORT_INPUT (void)
{
  GPIO_InitTypeDef GPIO_InitStruct;
  GPIO_InitStruct.Pin =0XFF;
  GPIO_InitStruct.Mode = GPIO_MODE_INPUT;
  GPIO_InitStruct.Speed = GPIO_SPEED_FREQ_HIGH;
  HAL_GPIO_Init(LCD_DATAPORT_MSB_PORT, &GPIO_InitStruct);
  HAL_GPIO_Init(LCD_DATAPORT_LSB_PORT, &GPIO_InitStruct);
} 

void LCD_DATAPORT_OUTPUT (void)
{
  GPIO_InitTypeDef GPIO_InitStruct;
  GPIO_InitStruct.Pin =0XFF;
  GPIO_InitStruct.Mode = GPIO_MODE_OUTPUT_PP;
  GPIO_InitStruct.Speed = GPIO_SPEED_FREQ_HIGH;
  HAL_GPIO_Init(LCD_DATAPORT_MSB_PORT, &GPIO_InitStruct);
  HAL_GPIO_Init(LCD_DATAPORT_LSB_PORT, &GPIO_InitStruct);
} 

void LCD_CONTROLPORT_PORT_OUTPUT(void)
{
  GPIO_InitTypeDef GPIO_InitStruct;
  GPIO_InitStruct.Pin=(1<<LCD_RST_PIN)|(1<<LCD_RS_PIN)|(1<<LCD_CS_PIN)|(1<<LCD_RD_PIN)|(1<<LCD_WR_PIN);
  GPIO_InitStruct.Mode = GPIO_MODE_OUTPUT_PP;
  GPIO_InitStruct.Speed = GPIO_SPEED_FREQ_HIGH;
  HAL_GPIO_Init(LCD_CONTROLPORT_PORT, &GPIO_InitStruct);
}  


//-----------------------------------------------------------------------
	// send a word data to the lcd
//-----------------------------------------------------------------------
void lcd_write_index_register(char ins)
    {
    CS_LOW;
    RS_LOW;
    LCD_DATAPORT_MSB_PORT->ODR=0x00; 
    LCD_DATAPORT_LSB_PORT->ODR=ins;
    WR_LOW; 
    WR_HIGH;
    CS_HIGH;        
    }
	
//-----------------------------------------------------------------------
	// write a word data into the WDR lcd register
//-----------------------------------------------------------------------
void lcd_write_wdr(int data)
    { 
    CS_LOW;
    RS_HIGH;
    LCD_DATAPORT_MSB_PORT->ODR=(data>>8); 
    LCD_DATAPORT_LSB_PORT->ODR=data; 
    WR_LOW;
    WR_HIGH;
    CS_HIGH;           
    }
	
//-----------------------------------------------------------------------
	// read data from rdr lcd register
//-----------------------------------------------------------------------
int lcd_read_rdr(void)
    { 
    int data_lsb,data_msb,rdr_data;  
    LCD_DATAPORT_CLEAR;
    LCD_DATAPORT_INPUT();
    RD_LOW;
	WR_HIGH;
	CS_LOW;
    //RS_HIGH;
    data_lsb=LCD_DATAPORT_LSB_PORT->IDR;
    data_msb=LCD_DATAPORT_MSB_PORT->IDR;
	rdr_data=((data_msb<<8)|data_lsb);
    CS_HIGH;
    RD_HIGH;
	WR_HIGH;
	LCD_DATAPORT_OUTPUT();
    return rdr_data;
    }


//-----------------------------------------------------------------------
	// clears the lcd panel
//-----------------------------------------------------------------------
void lcd_clear_screen(void)
    {  
    unsigned long int counter;
    lcd_write_index_register(TS_INS_GRAM_ADX);
    lcd_write_wdr(0);
    lcd_write_index_register(TS_INS_GRAM_ADY);
    lcd_write_wdr(0);             
    lcd_write_index_register(TS_INS_START_ADX);
    lcd_write_wdr(0);
    lcd_write_index_register(TS_INS_END_ADX);
    #ifdef PORTRAIT
    lcd_write_wdr(239);
    #else
    lcd_write_wdr(319); 
    #endif
    lcd_write_index_register(TS_INS_START_ADY);
    lcd_write_wdr(0);
    lcd_write_index_register(TS_INS_END_ADY);
    #ifdef PORTRAIT
    lcd_write_wdr(319);
    #else
    lcd_write_wdr(239); 
    #endif 
    lcd_write_index_register(TS_INS_RW_GRAM);
    for(counter=0;counter<76800;counter++)
      lcd_write_wdr(0xFFFF); 
    }
//-----------------------------------------------------------------------
	// set background color
//-----------------------------------------------------------------------
void lcd_background_color(int color)
    {  
    unsigned long int counter;
    lcd_write_index_register(TS_INS_GRAM_ADX);
    lcd_write_wdr(0);
    lcd_write_index_register(TS_INS_GRAM_ADY);
    lcd_write_wdr(0);             
    lcd_write_index_register(TS_INS_START_ADX);
    lcd_write_wdr(0);
    lcd_write_index_register(TS_INS_END_ADX);
    #ifdef PORTRAIT
    lcd_write_wdr(239);
    #else
    lcd_write_wdr(319); 
    #endif
    lcd_write_index_register(TS_INS_START_ADY);
    lcd_write_wdr(0);
    lcd_write_index_register(TS_INS_END_ADY);
    #ifdef PORTRAIT
    lcd_write_wdr(319);
    #else
    lcd_write_wdr(239); 
    #endif 
    lcd_write_index_register(TS_INS_RW_GRAM);
    for(counter=0;counter<76800;counter++)
      lcd_write_wdr(color); 
    }
	
//-----------------------------------------------------------------------	
	// lcd initialization
//-----------------------------------------------------------------------	
void lcd_init(void)
    { 
    LCD_DATAPORT_OUTPUT();
    LCD_CONTROLPORT_PORT->ODR|=(1<<LCD_RST_PIN)|(1<<LCD_RS_PIN)|(1<<LCD_CS_PIN)|(1<<LCD_RD_PIN)|(1<<LCD_WR_PIN);
    LCD_CONTROLPORT_PORT_OUTPUT();
    
          
    // reset lcd chipset
    RST_LOW;
    HAL_Delay(1);       
    RST_HIGH;          
    
    lcd_write_index_register(0x00E3);
    lcd_write_wdr(0x3008);                     //set the internal timing
    lcd_write_index_register(0x00E7);
    lcd_write_wdr(0x0012);                     //set the internal timing
    lcd_write_index_register(0x00EF);
    lcd_write_wdr(0x1231);                     //set the internal timing
    lcd_write_index_register(TS_INS_START_OSC);
    lcd_write_wdr(0x0001);                     //start oscillator
    HAL_Delay(50);

    lcd_write_index_register(TS_INS_DRIV_OUT_CTRL);
    lcd_write_wdr(0x0100);                     //set SS, SM
    lcd_write_index_register(TS_INS_DRIV_WAV_CTRL);
    lcd_write_wdr(0x0700);                     //set 1 line inversion
    
    lcd_write_index_register(TS_INS_ENTRY_MOD);
    lcd_write_wdr(TS_VAL_ENTRY_MOD);            //set GRAM write direction, BGR=0

    lcd_write_index_register(TS_INS_RESIZE_CTRL);
    lcd_write_wdr(0x0000);                     //no resizing

    lcd_write_index_register(TS_INS_DISP_CTRL2);
    lcd_write_wdr(0x0202);                     //front & back porch periods = 2
    lcd_write_index_register(TS_INS_DISP_CTRL3);
    lcd_write_wdr(0x0000);                     
    lcd_write_index_register(TS_INS_DISP_CTRL4);
    lcd_write_wdr(0x0000);                     
    lcd_write_index_register(TS_INS_RGB_DISP_IF_CTRL1);
    lcd_write_wdr(0x0000);                     //select system interface                
    lcd_write_index_register(TS_INS_FRM_MARKER_POS);
    lcd_write_wdr(0x0000);                     
    lcd_write_index_register(TS_INS_RGB_DISP_IF_CTRL2);
    lcd_write_wdr(0x0000);                    
    
    lcd_write_index_register(TS_INS_POW_CTRL1);
    lcd_write_wdr(0x0000);
    lcd_write_index_register(TS_INS_POW_CTRL2);
    lcd_write_wdr(0x0007);                     
    lcd_write_index_register(TS_INS_POW_CTRL3);
    lcd_write_wdr(0x0000);
    lcd_write_index_register(TS_INS_POW_CTRL4);
    lcd_write_wdr(0x0000);                     
    HAL_Delay(200);

    lcd_write_index_register(TS_INS_POW_CTRL1);
    lcd_write_wdr(0x1690);
    lcd_write_index_register(TS_INS_POW_CTRL2);
    lcd_write_wdr(0x0007); //lcd_write_wdr(0x0137);                     
    HAL_Delay(50);

    lcd_write_index_register(TS_INS_POW_CTRL3);
    lcd_write_wdr(0x001A); //lcd_write_wdr(0x013C);
    HAL_Delay(50);

    lcd_write_index_register(TS_INS_POW_CTRL4);
    lcd_write_wdr(0x1800); //lcd_write_wdr(0x1400);
    lcd_write_index_register(TS_INS_POW_CTRL7);
    lcd_write_wdr(0x002A); //lcd_write_wdr(0x0007);
    HAL_Delay(50);

    lcd_write_index_register(TS_INS_GRAM_HOR_AD);
    lcd_write_wdr(0x0000);
    lcd_write_index_register(TS_INS_GRAM_VER_AD);
    lcd_write_wdr(0x0000);

    lcd_write_index_register(TS_INS_GAMMA_CTRL1);
    lcd_write_wdr(0x0000);
    lcd_write_index_register(TS_INS_GAMMA_CTRL2);
    lcd_write_wdr(0x0000);
    lcd_write_index_register(TS_INS_GAMMA_CTRL3);
    lcd_write_wdr(0x0000);
    lcd_write_index_register(TS_INS_GAMMA_CTRL4);
    lcd_write_wdr(0x0000);
    lcd_write_index_register(TS_INS_GAMMA_CTRL5);
    lcd_write_wdr(0x0000);
    lcd_write_index_register(TS_INS_GAMMA_CTRL6);
    lcd_write_wdr(0x0406);
    lcd_write_index_register(TS_INS_GAMMA_CTRL7);
    lcd_write_wdr(0x0006);
    lcd_write_index_register(TS_INS_GAMMA_CTRL8);
    lcd_write_wdr(0x0404);
    lcd_write_index_register(TS_INS_GAMMA_CTRL9);
    lcd_write_wdr(0x0700);
    lcd_write_index_register(TS_INS_GAMMA_CTRL10);
    lcd_write_wdr(0x0A08);

    lcd_write_index_register(TS_INS_HOR_START_AD);
    lcd_write_wdr(0x0000);
    lcd_write_index_register(TS_INS_HOR_END_AD);
    lcd_write_wdr(0x00EF);
    lcd_write_index_register(TS_INS_VER_START_AD);
    lcd_write_wdr(0x0000);
    lcd_write_index_register(TS_INS_VER_END_AD);
    lcd_write_wdr(0x013F);
    lcd_write_index_register(TS_INS_GATE_SCAN_CTRL1);
    lcd_write_wdr(0xA700);
    lcd_write_index_register(TS_INS_GATE_SCAN_CTRL2);
    lcd_write_wdr(0x0001);
    lcd_write_index_register(TS_INS_GATE_SCAN_CTRL3);
    lcd_write_wdr(0x0000);

    lcd_write_index_register(TS_INS_PART_IMG1_DISP_POS);
    lcd_write_wdr(0x0000);
    lcd_write_index_register(TS_INS_PART_IMG1_START_AD);
    lcd_write_wdr(0x0000);
    lcd_write_index_register(TS_INS_PART_IMG1_END_AD);
    lcd_write_wdr(0x0000);
    lcd_write_index_register(TS_INS_PART_IMG2_DISP_POS);
    lcd_write_wdr(0x0000);
    lcd_write_index_register(TS_INS_PART_IMG2_START_AD);
    lcd_write_wdr(0x0000);
    lcd_write_index_register(TS_INS_PART_IMG2_END_AD);
    lcd_write_wdr(0x0000);

    lcd_write_index_register(TS_INS_PANEL_IF_CTRL1);
    lcd_write_wdr(0x0010);
    lcd_write_index_register(TS_INS_PANEL_IF_CTRL2);
    lcd_write_wdr(0x0000);
    lcd_write_index_register(TS_INS_PANEL_IF_CTRL3);
    lcd_write_wdr(0x0003);
    lcd_write_index_register(TS_INS_PANEL_IF_CTRL4);
    lcd_write_wdr(0x0110);
    lcd_write_index_register(TS_INS_PANEL_IF_CTRL5);
    lcd_write_wdr(0x0000);
    lcd_write_index_register(TS_INS_PANEL_IF_CTRL6);
    lcd_write_wdr(0x0000);

    lcd_write_index_register(TS_INS_DISP_CTRL1);
    lcd_write_wdr(0x0133);
    
    lcd_write_index_register(TS_INS_FRM_RATE_COL_CTRL);
    lcd_write_wdr(0x000D);
    
    lcd_clear_screen();
    }
	
//-----------------------------------------------------------------------
	// turn on a pixel on the lcd screen
//-----------------------------------------------------------------------
void lcd_write_pixel(unsigned int x,unsigned int y,int color)
    { 
    #ifdef LANDSCAPE
    y=239-y;
    #endif
    lcd_write_index_register(TS_INS_GRAM_ADX);
    lcd_write_wdr(x); 
    lcd_write_index_register(TS_INS_GRAM_ADY);
    lcd_write_wdr(y);
    lcd_write_index_register(TS_INS_START_ADX);
    lcd_write_wdr(x);
    lcd_write_index_register(TS_INS_END_ADX);
    lcd_write_wdr(x); 
    lcd_write_index_register(TS_INS_START_ADY);
    lcd_write_wdr(y);
    lcd_write_index_register(TS_INS_END_ADY);
    lcd_write_wdr(y); 
    lcd_write_index_register(TS_INS_RW_GRAM);
    lcd_write_wdr(color);
    }
//-----------------------------------------------------------------------
	// Read A Pixel Color On The LCD Screen
//-----------------------------------------------------------------------
int lcd_read_pixel(int x,int y)
    { 
		int pixel;
    #ifdef LANDSCAPE
    y=239-y;
    #endif
    lcd_write_index_register(TS_INS_GRAM_ADX);
    lcd_write_wdr(x); 
    lcd_write_index_register(TS_INS_GRAM_ADY);
    lcd_write_wdr(y);
    lcd_write_index_register(TS_INS_START_ADX);
    lcd_write_wdr(x);
    lcd_write_index_register(TS_INS_END_ADX);
    lcd_write_wdr(x); 
    lcd_write_index_register(TS_INS_START_ADY);
    lcd_write_wdr(y);
    lcd_write_index_register(TS_INS_END_ADY);
    lcd_write_wdr(y); 
    lcd_write_index_register(TS_INS_RW_GRAM);
	pixel=lcd_read_rdr();
    return pixel;
    }

//-----------------------------------------------------------------------
	// draw a line with x0,y0 and x1,y1 coordinates
//-----------------------------------------------------------------------	
void lcd_draw_line(int x0,int y0,int x1,int y1,int color) 
    {
    int dy=y1-y0;
    int dx=x1-x0;
    int stepx,stepy;
    if(dy<0) {dy=-dy;stepy=-1;} else {stepy=1;}
    if(dx<0) {dx=-dx;stepx=-1;} else {stepx=1;}
    dy<<=1; 
    dx<<=1; 
    lcd_write_pixel(x0,y0,color);
    if(dx>dy) 
      {
      int fraction=dy-(dx>>1); 
      while(x0!=x1) 
        {
        if(fraction>=0) 
          {
          y0+=stepy;
          fraction-=dx; 
          }
        x0+=stepx;
        fraction+=dy; 
        lcd_write_pixel(x0,y0,color);
        }
      } 
    else 
      {
      int fraction=dx-(dy>>1);
      while (y0 != y1) 
        {
        if(fraction>=0) 
          {
          x0+=stepx;
          fraction-=dy;
          }
        y0+=stepy;
        fraction+=dx;
        lcd_write_pixel(x0,y0,color);
        }
      }
    }
//-----------------------------------------------------------------------
	// draw a fill(1) or no fill(0) rectangular with specified color    
//-----------------------------------------------------------------------	

void lcd_draw_rectangle2(unsigned int x0,unsigned int y0,unsigned int x1,unsigned int y1,char fill,int color)
    { 
    if(fill)
      {
      unsigned int counter_x; 
      unsigned int counter_y; 
      
      lcd_write_index_register(TS_INS_GRAM_ADX);
      lcd_write_wdr(x0);
      lcd_write_index_register(TS_INS_GRAM_ADY);
      lcd_write_wdr(y0);  
      lcd_write_index_register(TS_INS_START_ADX);
      lcd_write_wdr(x0);
      lcd_write_index_register(TS_INS_END_ADX);
      lcd_write_wdr(x1);
      #ifdef PORTRAIT
      lcd_write_index_register(TS_INS_START_ADY);
      lcd_write_wdr(y0);
      lcd_write_index_register(TS_INS_END_ADY);
      lcd_write_wdr(y1); 
      #else
      lcd_write_index_register(TS_INS_START_ADY);
      lcd_write_wdr(239-y1);
      lcd_write_index_register(TS_INS_END_ADY);
      lcd_write_wdr(239-y0);
      #endif  
      lcd_write_index_register(TS_INS_RW_GRAM);
      for(counter_y=y0;counter_y<=y1;counter_y++)
        {
        for(counter_x=x0;counter_x<=x1;counter_x++)
          lcd_write_wdr(color);
        }  
      } 
    else
      {
      lcd_draw_line(x0,y0,x1,y0,color);
      lcd_draw_line(x1,y0,x1,y1,color);
      lcd_draw_line(x1,y1,x0,y1,color); 
      lcd_draw_line(x0,y1,x0,y0,color);
      }
    }
  
void lcd_draw_rectangle(unsigned int x0,unsigned int y0,unsigned int x1,unsigned int y1,int color)
{ 
      lcd_draw_line(x0,y0,x1,y0,color);
      lcd_draw_line(x1,y0,x1,y1,color);
      lcd_draw_line(x1,y1,x0,y1,color); 
      lcd_draw_line(x0,y1,x0,y0,color);
}
//-----------------------------------------------------------------------
	// draw a fill(1) or no fill(0) circle with specified color 
//-----------------------------------------------------------------------	
void lcd_draw_circle(unsigned int x0,unsigned int y0,unsigned int radius,char fill,int color) 
    { 
    int x_offset,y_offset,error; 
    x_offset=0; 
    y_offset=radius; 
    error=1-radius; 

    do 
      { 
      if(fill) 
        { 
        lcd_draw_line(x0-x_offset,y0+y_offset,x0+x_offset,y0+y_offset,color); 
        lcd_draw_line(x0-x_offset,y0-y_offset,x0+x_offset,y0-y_offset,color); 
        lcd_draw_line(x0-y_offset,y0+x_offset,x0+y_offset,y0+x_offset,color); 
        lcd_draw_line(x0-y_offset,y0-x_offset,x0+y_offset,y0-x_offset,color); 
        } 
      else 
        { 
        lcd_write_pixel(x_offset+x0,y_offset+y0,color); 
        lcd_write_pixel(y_offset+x0,x_offset+y0,color); 
        lcd_write_pixel(x0-x_offset,y_offset+y0,color); 
        lcd_write_pixel(x0-y_offset,x_offset+y0,color); 
        lcd_write_pixel(y_offset+x0,y0-x_offset,color); 
        lcd_write_pixel(x_offset+x0,y0-y_offset,color); 
        lcd_write_pixel(x0-x_offset,y0-y_offset,color); 
        lcd_write_pixel(x0-y_offset,y0-x_offset,color); 
        } 

      if(error<0) 
        error+=(3+(2*(x_offset++))); 
      else 
        error+=(5+(2*((x_offset++)-(y_offset--)))); 
      }while(x_offset<=y_offset); 
    } 

//-----------------------------------------------------------------------
	// Show A Picture On The LCD Screen
//-----------------------------------------------------------------------
void lcd_write_pic(unsigned int x,unsigned int y,const unsigned int *pointer)
     {
     unsigned long int counter,compare_value=(unsigned long int)pointer[0]*pointer[1];
     lcd_write_index_register(TS_INS_GRAM_ADX);
     lcd_write_wdr(x); 
     lcd_write_index_register(TS_INS_START_ADX);
     lcd_write_wdr(x);
     lcd_write_index_register(TS_INS_END_ADX);
     lcd_write_wdr(x+pointer[0]-1);   
     #ifdef PORTRAIT
     lcd_write_index_register(TS_INS_GRAM_ADY);
     lcd_write_wdr(y);
     lcd_write_index_register(TS_INS_START_ADY);
     lcd_write_wdr(y);
     lcd_write_index_register(TS_INS_END_ADY);
     lcd_write_wdr(y+pointer[1]-1);
     #else     
     lcd_write_index_register(TS_INS_GRAM_ADY);
     lcd_write_wdr(239-y);
     lcd_write_index_register(TS_INS_START_ADY);
     lcd_write_wdr(239-(y+pointer[1]));
     lcd_write_index_register(TS_INS_END_ADY);
     lcd_write_wdr(239-y);
     #endif 
     lcd_write_index_register(TS_INS_RW_GRAM);  
     for(counter=0,pointer+=2;counter<compare_value;counter++,pointer++)
       lcd_write_wdr(*pointer);
     }

//-----------------------------------------------------------------------	 
	// This Functions Goes The Cursor To X And Y Positions
//-----------------------------------------------------------------------	 
void lcd_gotoxy(unsigned char x,unsigned char y)
    {
    if(x>40 || y>15) 
        {
        y+=x/40;
        x%=40;
        }
    x_text=x;
    y_text=y;
    }
	
//-----------------------------------------------------------------------	
	// Puts A Character On The LCD Screen
//-----------------------------------------------------------------------	
void lcd_putchar(char character,int forground_color,char background_color_activation,int background_color)
    {  
    int temporary_color;
    unsigned char width_counter,length_counter;
    char character_segment_data;
    for(length_counter=0;length_counter<16;length_counter++)
        {
        character_segment_data=font8x16[character-0x20][length_counter];
        for(width_counter=0;width_counter<8;width_counter++)
            {
            if(character_segment_data&(128>>width_counter)) 
              lcd_write_pixel(((int)x_text*8)+width_counter,((int)y_text*16)+length_counter,forground_color);
            else 
              {
              if(background_color_activation)
                {
                temporary_color=lcd_read_rdr();
                temporary_color=lcd_read_rdr();
                lcd_write_wdr(temporary_color);
                } 
              else
                lcd_write_pixel(((int)x_text*8)+width_counter,((int)y_text*16)+length_counter,background_color);
              }            
            }
        }
    
    if(++x_text>40)
        {            
        x_text=0;
        if(++y_text>15) y_text=0;
        }
    } 

//-----------------------------------------------------------------------	
	// Show A String That Stored In The Flash Memory Of The Microcontroller  
//-----------------------------------------------------------------------	
void lcd_putsf(const char *string,int forground_color,char background_color_activation,int background_color)
    {
    while(*string)
      lcd_putchar(*string++,forground_color,background_color_activation,background_color);
    }
//-----------------------------------------------------------------------	
	// Show A String That Stored In The SRAM Of The Microcontroller    
//-----------------------------------------------------------------------	
void lcd_puts(char *string,int forground_color,char background_color_activation,int background_color)
    {
    while(*string)
      lcd_putchar(*string++,forground_color,background_color_activation,background_color);
    }


